#include <behaviors.dtsi>
#include <dt-bindings/zmk/keys.h>
#include <dt-bindings/zmk/bt.h>
#include <dt-bindings/zmk/outputs.h>
#include <dt-bindings/zmk/pointing.h>

#include "forager-keys.dtsi"

#include "forager-behaviors.dtsi"
#include "forager-macros.dtsi"
#include "forager-combos.dtsi"
#include "forager-layers.dtsi"

// Tap-then-hold repeats the tap instead of activating the hold (layer) -
// e.g. tap Backspace once, hold right after to keep deleting via NUM_TAB/
// &brac_bspc/etc. without losing the layer-hold on a genuine cold hold.
&lt {
    quick-tap-ms = <200>;
};
