/ {
    macros {
        clipboard_manager: clipboard_manager {
            compatible = "zmk,behavior-macro";
            #binding-cells = <0>;
            bindings
                = <&macro_press &kp LGUI>
                , <&macro_press &kp SPACE>
                , <&macro_tap &kp N4>
                , <&macro_release &kp SPACE>
                , <&macro_release &kp LGUI>
                ;
        };

        fat_arrow: fat_arrow {
            compatible = "zmk,behavior-macro";
            #binding-cells = <0>;
            bindings = <&kp EQUAL &kp GT>;
        };
    };
};
