## Kconfig
```kconfig
config FORAGER_BATTERY_RESEND
    bool "Re-send this half's battery level to the dongle"
    default y
    depends on ZMK_SPLIT && !ZMK_SPLIT_ROLE_CENTRAL && ZMK_BATTERY_REPORTING
    help
      ZMK only sends a peripheral's battery level when the level changes
      (and once at boot). Over BLE the central fetches it on connect, but
      ESB is connectionless, so a dongle powered on after the halves would
      show no battery until the level next changes. This re-sends the
      current level after a pause in typing, when the last send is old
      enough.

if FORAGER_BATTERY_RESEND

config FORAGER_BATTERY_RESEND_MIN_GAP_S
    int "Seconds between re-sends, at least"
    default 60

config FORAGER_BATTERY_RESEND_QUIET_MS
    int "Send once no key on this half changed for this many milliseconds"
    default 2000

endif
```

## config/west.yml
```yaml
manifest:
  remotes:
    - name: zmkfirmware
      url-base: https://github.com/zmkfirmware
    - name: carrefinho 
      url-base: https://github.com/carrefinho     
    - name: caksoylar  
      url-base: https://github.com/caksoylar      
    - name: badjeff
      url-base: https://github.com/badjeff
    - name: nrfconnect
      url-base: https://github.com/nrfconnect
    - name: wominik
      url-base: https://github.com/Wominik
  projects:
    - name: zmk
      remote: zmkfirmware
      revision: fa33e35f11d2b15311973cda9fb89dcd2376888c
      import: app/west.yml
    - name: forager-zmk-module  
      remote: carrefinho        
      revision: 3cafe6b7b26d7b538949e138fc00a148def4b2ed 
    - name: zmk-rgbled-widget
      remote: caksoylar
      revision: e6b467792a1dabef8cfa5c9fd26bfefc9c16662b
    - name: prospector-zmk-module
      # Fork of carrefinho/prospector-zmk-module @ feat/new-status-screens
      # (ed98221) + one commit making it build without BLE, which the ESB
      # split transport requires.
      remote: wominik
      revision: 5d53c1de159c717530a714bec0cedcf861b298e1
    # ESB split transport + the Nordic SDK pieces it needs (NCS 3.1, patched
    # by the module author to pass ZMK 0.4 / Zephyr 4.1 CMake validation)
    - name: zmk-feature-split-esb
      remote: badjeff
      revision: 314c7cbaf4a74e1add1d6ffc8249de3e29965b8c # main, 2026-08-11
    - name: sdk-nrf
      remote: badjeff
      revision: 9b3d2623fdcd9c0fd0284f860beea924568c9826 # v3.1-branch+zmk-fixes
      path: nrf
    - name: nrfxlib
      remote: nrfconnect
      repo-path: sdk-nrfxlib
      revision: dfadf17305d8f000eda9aa74a5b9ff1c5647a23e # v3.1-branch
      path: nrfxlib
  self:
    path: config
```
